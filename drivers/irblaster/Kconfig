## drivers/irblaster/Kconfig
```kconfig
#
# Input core configuration
#
config IRBLASTER_DETECTION
	boolean "Irblaster device detection surport"
	default n
	help
	  Say Y here if you want to use the irblaster detection.
```

## drivers/mstar2/drv/ipa_pool/Kconfig
```kconfig
config MSTAR_IPAPOOL
bool  "IPA POOL"
depends on (CMA && !MSTAR_CMAPOOL)
select MSTAR_MIU
default n

help
    MStar IPA POOL driver function

config MSTAR_IPAPOOL_DELAY_FREE
bool  "IPA POOL Delay Free"
depends on MSTAR_IPAPOOL 
default y

help
    Ipa pool delay free

config MSTAR_MIUSLITS
bool  "MIU SLITS"
depends on MSTAR_IPAPOOL 
select MSTAR_MIU
default n

help
    IPA HEAP kernel protected by MIU SLits    
```

## drivers/mstar2/drv/leds/Kconfig
```kconfig
config HAS_LED
	tristate "TV Status Led"
	default y
	help
	    enable MStar tv status led driver.
```

## drivers/mstar2/drv/mbx/Kconfig
```kconfig
config MSTAR_MBX
tristate "MBX"
default y
help
    enable MStar MBX driver.

config MSTAR_MBX_GROUP_PATH
tristate "MBX_GROUP"
depends on MSTAR_MBX
default n
help
    enable MStar MBX group patch
```

## drivers/mstar2/drv/mt76x8/Kconfig
```kconfig
config MT76X8_CHIP_RESET

tristate "MT76x8 Whole Chip Reset"
select MSTAR_GPIO
help
    Meditech MT76x8 Whole Chip Reset function
```

## drivers/mstar2/drv/netflix/Kconfig
```kconfig
config NETFLIX_CRASH_MONITOR
	bool "Netflix Crash Monitor"
	default n
	help
		Netflix Crash Monitor
```

## drivers/mstar2/drv/pwm/Kconfig
```kconfig
config MSTAR_PWM


tristate "PWM"
default n

---help---
Enable compilation option for driver PWM
```

## drivers/mstar2/drv/system/Kconfig
```kconfig
config MSTAR_SYSTEM
	tristate "System"
	select CRC32
  default y

config MSTAR_UTOPIA2K_MDEBUG
	bool "UTOPIA2K_MDEBUG"
  default n
```

## drivers/mstar2/drv/voice/Kconfig
```kconfig
menuconfig MSTAR_VOICE
	tristate "Voice driver"
	select SOUND
	select SND
	select SND_SOC
	select SND_PCM
	select SND_HWDEP
	help
	  Say Y or M if you want to add support for
	  the cleveland Voice driver.

#if MSTAR_VOICE	  
	  
config MSTAR_VOICE_DRIVER_DRV
    tristate "voide support for cleveland"
    depends on MSTAR_VOICE
#    depends on ARCH_CLEVELAND

config MSTAR_VOICE_DRIVER_HAL
    tristate "voide support for cleveland"
    depends on MSTAR_VOICE_DRIVER_DRV

#endif #MSTAR_VOICE
```

## drivers/staging/amazon/Kconfig
```kconfig
menu "Amazon"

config AMAZON
	bool "Amazon Drivers"

	default N
	---help---
	  Enable support for various drivers needed on the Amazon Fire OS platform

if AMAZON

config AMAZON_SIGN_OF_LIFE
	bool "Amazon Sign of Life"
	default N
	---help---
          Use to log device boot and shutdown metrics.
          This is a generic driver, the platform part is implemented
          to do the real work.

config AMAZON_SIGN_OF_LIFE_MSTAR
	bool "Amazon Sign of Life MStar platform implementation"
	depends on AMAZON_SIGN_OF_LIFE
	default N
	---help---
        The life cycle is implemented on MStar platform to record
        boot/shutdown information.


config AMAZON_METRICS_LOG
	bool "Amazon Metrics logger driver"
	select RING_BUFFER
	default n
	---help---
		Enable Amazon Metrics/Vitals logger driver

config AMAZON_METRICS_LOG_TEST
	tristate "Amazon Metrics logger driver test module"
	depends on AMAZON_METRICS_LOG
	default n
	---help---
		Enable Amazon Metrics/Vitals logger test module

config AMAZON_SILENT_OTA_BACKLIGHT
	bool "Amazon silent ota backlight control"
	default n
	---help---
		Enable Amazon silent ota backlight control

endif # if AMAZON

endmenu
```
